## Kconfig
```kconfig
# Copyright (c) 2017 Linaro Limited
#
# SPDX-License-Identifier: Apache-2.0
#

mainmenu "LWM2M application configuration"

config ZEPHYR_BASE
	string
	option env="ZEPHYR_BASE"

source "$ZEPHYR_BASE/Kconfig.zephyr"

config FOTA_DEVICE
	bool "Enable FOTA device settings"
	default y
	select FOTA_DEVICE_SOC_SERIES_KINETIS_K6X if SOC_SERIES_KINETIS_K6X
	select FOTA_DEVICE_SOC_SERIES_NRF52X if SOC_SERIES_NRF52X
	help
	  Main config to enable device specific settings

config FOTA_DEVICE_SOC_SERIES_KINETIS_K6X
	bool "Kinetis K6x FOTA settings"
	select NET_SHELL
	select NET_IPV4
	select NET_APP_NEED_IPV4
	default n

config FOTA_DEVICE_SOC_SERIES_NRF52X
	bool "Nordic Semiconductor nRF52 FOTA settings"
	select NET_L2_BT
	select NET_IPV6
	select NET_APP_NEED_IPV6
	select SENSOR
	select TEMP_NRF5
	default n

config FOTA_LED_GPIO_INVERTED
	bool "Set this if your hardware has an inverted LED GPIO"
	default n
	help
	  This setting is used to invert the GPIO pin settings when toggling
	  the "Light Control" LED.

if FOTA_DEVICE_SOC_SERIES_NRF52X

config TEMP_NRF5_NAME
	default "fota-temp"

endif # FOTA_DEVICE_SOC_SERIES_NRF52X

config FOTA_SYSLOG_SUPPORT
	bool "Enable FOTA syslog support"
	select SYS_LOG_EXT_HOOK
	select FILE_SYSTEM
	select FLASH_MAP
	select FLASH_MAP_CUSTOM
	select FCB
	default n
	help
	  Enable this setting to support FCB-backed syslog storage.

if FOTA_SYSLOG_SUPPORT

config FOTA_SYSLOG_SECTOR_COUNT
	int "System Log sector count"
	depends on FOTA_SYSLOG_SUPPORT
	default 2
	help
	  This is the number of sectors in the flash area where the syslog
	  will be stored.

config FOTA_SYSLOG_SECTOR_SIZE
	int "System Log sector size"
	depends on FOTA_SYSLOG_SUPPORT
	default 4096
	help
	  This is the size of each syslog sector.

config FOTA_SYSLOG_ENABLED
	bool "System Log enabled at start"
	depends on FOTA_SYSLOG_SUPPORT
	default false
	help
	  This setting will start the syslog by default.

config FOTA_SYSLOG_SHELL
	bool "Enable shell commands to manage System Log"
	depends on FOTA_SYSLOG_SUPPORT
	select CONSOLE_SHELL
	default false
	help
	  This setting will enable the "log" shell command to manage the
	  System Log via UART.

endif # FOTA_SYSLOG_SUPPORT

config SYS_LOG_FOTA_LEVEL
	int "FOTA log level"
	depends on SYS_LOG && FOTA_DEVICE
	default 0
	range 0 4
	help
	  Set the log level for the FOTA library.

	  The available levels are:

	  - 0 OFF: do not write
	  - 1 ERROR: only write SYS_LOG_ERR
	  - 2 WARNING: write SYS_LOG_WRN in addition to previous level
	  - 3 INFO: write SYS_LOG_INF in addition to previous levels
	  - 4 DEBUG: write SYS_LOG_DBG in addition to previous levels
```

## boards/reel_board.conf
```kconfig
# LED GPIO is inverted
CONFIG_FOTA_LED_GPIO_INVERTED=y

# Ambient Temperature Sensor
CONFIG_I2C=y
CONFIG_HDC1008=y

# Display
CONFIG_SPI=y
CONFIG_HEAP_MEM_POOL_SIZE=16384
CONFIG_DISPLAY=y
CONFIG_SSD1673=y
CONFIG_CHARACTER_FRAMEBUFFER=y
CONFIG_LWM2M_IPSO_DISPLAY=y
```
